## boards/shields/split84/Kconfig.defconfig
```kconfig
if SHIELD_SPLIT84_LEFT

config ZMK_KEYBOARD_NAME
	default "Split84"

config ZMK_SPLIT_ROLE_CENTRAL
	default y

endif

if SHIELD_SPLIT84_LEFT || SHIELD_SPLIT84_RIGHT

config ZMK_SPLIT
	default y

config ZMK_SLEEP
	default y

endif
```

## boards/shields/split84/Kconfig.shield
```kconfig
config SHIELD_SPLIT84_LEFT
    def_bool $(shields_list_contains,split84_left)

config SHIELD_SPLIT84_RIGHT
    def_bool $(shields_list_contains,split84_right)
```
